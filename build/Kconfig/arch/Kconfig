## build/Kconfig/arch/Kconfig
```kconfig
# Load Zephyr Arch Kconfig descriptions.
osource "/home/khaiwic/zephyrproject/zephyr/arch/rx/Kconfig"
osource "/home/khaiwic/zephyrproject/zephyr/arch/x86/Kconfig"
osource "/home/khaiwic/zephyrproject/zephyr/arch/xtensa/Kconfig"
osource "/home/khaiwic/zephyrproject/zephyr/arch/sparc/Kconfig"
osource "/home/khaiwic/zephyrproject/zephyr/arch/riscv/Kconfig"
osource "/home/khaiwic/zephyrproject/zephyr/arch/posix/Kconfig"
osource "/home/khaiwic/zephyrproject/zephyr/arch/openrisc/Kconfig"
osource "/home/khaiwic/zephyrproject/zephyr/arch/mips/Kconfig"
osource "/home/khaiwic/zephyrproject/zephyr/arch/arm64/Kconfig"
osource "/home/khaiwic/zephyrproject/zephyr/arch/arm/Kconfig"
osource "/home/khaiwic/zephyrproject/zephyr/arch/arc/Kconfig"
```

## build/Kconfig/boards/Kconfig.defconfig
```kconfig
# Load Zephyr board defconfig descriptions.
osource "/home/khaiwic/zephyrproject/zephyr/boards/espressif/esp32s3_devkitc/Kconfig.defconfig"
```

## build/Kconfig/boards/Kconfig.stm32_min_dev
```kconfig
# Load board Kconfig descriptions.
osource "/home/khaiwic/zephyrproject/zephyr/boards/others/stm32_min_dev/Kconfig.stm32_min_dev"
```

## build/Kconfig/boards/Kconfig.sysbuild
```kconfig
# Load Sysbuild board Kconfig descriptions.
osource "/home/khaiwic/zephyrproject/zephyr/boards/others/stm32_min_dev/Kconfig.sysbuild"
```
